# ATBTLC1000WLCSP device description
Architecture: CORTEX-M0; Family: SAMB; Series: SAMB11
Parameters: PIO_API=samb, LITTLE_ENDIAN=1, __FPU_PRESENT=0, __CM0_REV=0x00, __NVIC_PRIO_BITS=2, __Vendor_SysTickConfig=0
Programming and debug interfaces: SWD
Registers are 32-bit, read-write, reset 0x0 unless marked. A register's access mark holds for its fields unless they carry their own. Offsets are from the block's base; lines under a group give offsets from that group; [hi:lo] are bit positions; {n}, {i} and the like mark numbered series; 'fields as' and 'values as' point back to an identical list; <NAME> marks a mode.

## Ordering variants
BTLC1000WLCSP-MU: WLCSP31, pinout BTLC1000WLCSP, up to 26 MHz, -40 to 85 C, 2.30 to 3.60 V

## Memory
base space: start 0 size 0x10042000, little endian
  0x0 BOOTROM size 0x20000 rom
  0x10000000 IDRAM size 0x20000 ram
  0x10040000 BLERAM size 0x2000 ram
  0x40000000 APB size 0x20000 io
extflash space: start 0 size 0x20000

## Peripheral instances (address, pins/pin function, parameters)
TIMER0 at 0x40000000 (TIMER)
DUALTIMER0 at 0x40001000 (DUALTIMER)
PROV_DMA_CTRL0 at 0x40002000 (PROV_DMA_CTRL)
I2C0 at 0x40003000 (I2C)
  pins: SDA LP_GPIO_8/M_I2C0_SDA or LP_GPIO_0/M_I2C0_SDA or LP_GPIO_1/M_I2C0_SDA or LP_GPIO_2/M_I2C0_SDA or LP_GPIO_3/M_I2C0_SDA or LP_GPIO_9/M_I2C0_SDA or LP_GPIO_10/M_I2C0_SDA or LP_GPIO_11/M_I2C0_SDA or LP_GPIO_12/M_I2C0_SDA or LP_GPIO_13/M_I2C0_SDA; SCL LP_GPIO_9/M_I2C0_SCL or LP_GPIO_0/M_I2C0_SCL or LP_GPIO_1/M_I2C0_SCL or LP_GPIO_2/M_I2C0_SCL or LP_GPIO_3/M_I2C0_SCL or LP_GPIO_8/M_I2C0_SCL or LP_GPIO_10/M_I2C0_SCL or LP_GPIO_11/M_I2C0_SCL or LP_GPIO_12/M_I2C0_SCL or LP_GPIO_13/M_I2C0_SCL
I2C1 at 0x40003400 (I2C)
  pins: SDA LP_GPIO_0/M_I2C1_SDA or LP_GPIO_1/M_I2C1_SDA or LP_GPIO_2/M_I2C1_SDA or LP_GPIO_3/M_I2C1_SDA or LP_GPIO_8/M_I2C1_SDA or LP_GPIO_9/M_I2C1_SDA or LP_GPIO_10/M_I2C1_SDA or LP_GPIO_11/M_I2C1_SDA or LP_GPIO_12/M_I2C1_SDA or LP_GPIO_13/M_I2C1_SDA; SCL LP_GPIO_0/M_I2C1_SCL or LP_GPIO_1/M_I2C1_SCL or LP_GPIO_2/M_I2C1_SCL or LP_GPIO_3/M_I2C1_SCL or LP_GPIO_8/M_I2C1_SCL or LP_GPIO_9/M_I2C1_SCL or LP_GPIO_10/M_I2C1_SCL or LP_GPIO_11/M_I2C1_SCL or LP_GPIO_12/M_I2C1_SCL or LP_GPIO_13/M_I2C1_SCL
UART0 at 0x40004000 (UART)
  pins: RXD LP_GPIO_2/M_UART0_RXD or LP_GPIO_0/M_UART0_RXD or LP_GPIO_1/M_UART0_RXD or LP_GPIO_3/M_UART0_RXD or LP_GPIO_8/M_UART0_RXD or LP_GPIO_9/M_UART0_RXD or LP_GPIO_10/M_UART0_RXD or LP_GPIO_11/M_UART0_RXD or LP_GPIO_12/M_UART0_RXD or LP_GPIO_13/M_UART0_RXD; TXD LP_GPIO_3/M_UART0_TXD or LP_GPIO_0/M_UART0_TXD or LP_GPIO_1/M_UART0_TXD or LP_GPIO_2/M_UART0_TXD or LP_GPIO_8/M_UART0_TXD or LP_GPIO_9/M_UART0_TXD or LP_GPIO_10/M_UART0_TXD or LP_GPIO_11/M_UART0_TXD or LP_GPIO_12/M_UART0_TXD or LP_GPIO_13/M_UART0_TXD; CTS LP_GPIO_0/M_UART0_CTS or LP_GPIO_1/M_UART0_CTS or LP_GPIO_2/M_UART0_CTS or LP_GPIO_3/M_UART0_CTS or LP_GPIO_8/M_UART0_CTS or LP_GPIO_9/M_UART0_CTS or LP_GPIO_10/M_UART0_CTS or LP_GPIO_11/M_UART0_CTS or LP_GPIO_12/M_UART0_CTS or LP_GPIO_13/M_UART0_CTS; RTS LP_GPIO_0/M_UART0_RTS or LP_GPIO_1/M_UART0_RTS or LP_GPIO_2/M_UART0_RTS or LP_GPIO_3/M_UART0_RTS or LP_GPIO_8/M_UART0_RTS or LP_GPIO_9/M_UART0_RTS or LP_GPIO_10/M_UART0_RTS or LP_GPIO_11/M_UART0_RTS or LP_GPIO_12/M_UART0_RTS or LP_GPIO_13/M_UART0_RTS
UART1 at 0x40005000 (UART)
  pins: RXD LP_GPIO_0/M_UART1_RXD or LP_GPIO_1/M_UART1_RXD or LP_GPIO_2/M_UART1_RXD or LP_GPIO_3/M_UART1_RXD or LP_GPIO_8/M_UART1_RXD or LP_GPIO_9/M_UART1_RXD or LP_GPIO_10/M_UART1_RXD or LP_GPIO_11/M_UART1_RXD or LP_GPIO_12/M_UART1_RXD or LP_GPIO_13/M_UART1_RXD; TXD LP_GPIO_0/M_UART1_TXD or LP_GPIO_1/M_UART1_TXD or LP_GPIO_2/M_UART1_TXD or LP_GPIO_3/M_UART1_TXD or LP_GPIO_8/M_UART1_TXD or LP_GPIO_9/M_UART1_TXD or LP_GPIO_10/M_UART1_TXD or LP_GPIO_11/M_UART1_TXD or LP_GPIO_12/M_UART1_TXD or LP_GPIO_13/M_UART1_TXD; CTS LP_GPIO_0/M_UART1_CTS or LP_GPIO_1/M_UART1_CTS or LP_GPIO_2/M_UART1_CTS or LP_GPIO_3/M_UART1_CTS or LP_GPIO_8/M_UART1_CTS or LP_GPIO_9/M_UART1_CTS or LP_GPIO_10/M_UART1_CTS or LP_GPIO_11/M_UART1_CTS or LP_GPIO_12/M_UART1_CTS or LP_GPIO_13/M_UART1_CTS; RTS LP_GPIO_0/M_UART1_RTS or LP_GPIO_1/M_UART1_RTS or LP_GPIO_2/M_UART1_RTS or LP_GPIO_3/M_UART1_RTS or LP_GPIO_8/M_UART1_RTS or LP_GPIO_9/M_UART1_RTS or LP_GPIO_10/M_UART1_RTS or LP_GPIO_11/M_UART1_RTS or LP_GPIO_12/M_UART1_RTS or LP_GPIO_13/M_UART1_RTS
SPI0 at 0x40006000 (SPI)
  pins: SCK LP_GPIO_2/SPI0_SCK or LP_GPIO_10/SPI0_SCK; MOSI LP_GPIO_3/SPI0_MOSI or LP_GPIO_11/SPI0_MOSI; SSN LP_GPIO_8/SPI0_SSN or LP_GPIO_12/SPI0_SSN; MISO LP_GPIO_9/SPI0_MISO or LP_GPIO_13/SPI0_MISO
WDT0 at 0x40008000 (WDT)
WDT1 at 0x40009000 (WDT)
EFUSE_MISC_REGS0 at 0x4000A000 (EFUSE_MISC_REGS)
LPMCU_MISC_REGS0 at 0x4000B000 (LPMCU_MISC_REGS)
  pins: PWM0_OUT LP_GPIO_0/M_PWM0_OUT or LP_GPIO_1/M_PWM0_OUT or LP_GPIO_2/M_PWM0_OUT or LP_GPIO_3/M_PWM0_OUT or LP_GPIO_8/M_PWM0_OUT or LP_GPIO_9/M_PWM0_OUT or LP_GPIO_10/M_PWM0_OUT or LP_GPIO_11/M_PWM0_OUT or LP_GPIO_12/M_PWM0_OUT or LP_GPIO_13/M_PWM0_OUT; PWM1_OUT LP_GPIO_0/M_PWM1_OUT or LP_GPIO_1/M_PWM1_OUT or LP_GPIO_2/M_PWM1_OUT or LP_GPIO_3/M_PWM1_OUT or LP_GPIO_8/M_PWM1_OUT or LP_GPIO_9/M_PWM1_OUT or LP_GPIO_10/M_PWM1_OUT or LP_GPIO_11/M_PWM1_OUT or LP_GPIO_12/M_PWM1_OUT or LP_GPIO_13/M_PWM1_OUT; PWM2_OUT LP_GPIO_0/M_PWM2_OUT or LP_GPIO_1/M_PWM2_OUT or LP_GPIO_2/M_PWM2_OUT or LP_GPIO_3/M_PWM2_OUT or LP_GPIO_8/M_PWM2_OUT or LP_GPIO_9/M_PWM2_OUT or LP_GPIO_10/M_PWM2_OUT or LP_GPIO_11/M_PWM2_OUT or LP_GPIO_12/M_PWM2_OUT or LP_GPIO_13/M_PWM2_OUT; PWM3_OUT LP_GPIO_0/M_PWM3_OUT or LP_GPIO_1/M_PWM3_OUT or LP_GPIO_2/M_PWM3_OUT or LP_GPIO_3/M_PWM3_OUT or LP_GPIO_8/M_PWM3_OUT or LP_GPIO_9/M_PWM3_OUT or LP_GPIO_10/M_PWM3_OUT or LP_GPIO_11/M_PWM3_OUT or LP_GPIO_12/M_PWM3_OUT or LP_GPIO_13/M_PWM3_OUT; QUAD_DEC0_A LP_GPIO_0/M_QUAD_DEC0_A or LP_GPIO_1/M_QUAD_DEC0_A or LP_GPIO_2/M_QUAD_DEC0_A or LP_GPIO_3/M_QUAD_DEC0_A or LP_GPIO_8/M_QUAD_DEC0_A or LP_GPIO_9/M_QUAD_DEC0_A or LP_GPIO_10/M_QUAD_DEC0_A or LP_GPIO_11/M_QUAD_DEC0_A or LP_GPIO_12/M_QUAD_DEC0_A or LP_GPIO_13/M_QUAD_DEC0_A; QUAD_DEC0_B LP_GPIO_0/M_QUAD_DEC0_B or LP_GPIO_1/M_QUAD_DEC0_B or LP_GPIO_2/M_QUAD_DEC0_B or LP_GPIO_3/M_QUAD_DEC0_B or LP_GPIO_8/M_QUAD_DEC0_B or LP_GPIO_9/M_QUAD_DEC0_B or LP_GPIO_10/M_QUAD_DEC0_B or LP_GPIO_11/M_QUAD_DEC0_B or LP_GPIO_12/M_QUAD_DEC0_B or LP_GPIO_13/M_QUAD_DEC0_B; QUAD_DEC1_A LP_GPIO_0/M_QUAD_DEC1_A or LP_GPIO_1/M_QUAD_DEC1_A or LP_GPIO_2/M_QUAD_DEC1_A or LP_GPIO_3/M_QUAD_DEC1_A or LP_GPIO_8/M_QUAD_DEC1_A or LP_GPIO_9/M_QUAD_DEC1_A or LP_GPIO_10/M_QUAD_DEC1_A or LP_GPIO_11/M_QUAD_DEC1_A or LP_GPIO_12/M_QUAD_DEC1_A or LP_GPIO_13/M_QUAD_DEC1_A; QUAD_DEC1_B LP_GPIO_0/M_QUAD_DEC1_B or LP_GPIO_1/M_QUAD_DEC1_B or LP_GPIO_2/M_QUAD_DEC1_B or LP_GPIO_3/M_QUAD_DEC1_B or LP_GPIO_8/M_QUAD_DEC1_B or LP_GPIO_9/M_QUAD_DEC1_B or LP_GPIO_10/M_QUAD_DEC1_B or LP_GPIO_11/M_QUAD_DEC1_B or LP_GPIO_12/M_QUAD_DEC1_B or LP_GPIO_13/M_QUAD_DEC1_B; QUAD_DEC2_A LP_GPIO_0/M_QUAD_DEC2_A or LP_GPIO_1/M_QUAD_DEC2_A or LP_GPIO_2/M_QUAD_DEC2_A or LP_GPIO_3/M_QUAD_DEC2_A or LP_GPIO_8/M_QUAD_DEC2_A or LP_GPIO_9/M_QUAD_DEC2_A or LP_GPIO_10/M_QUAD_DEC2_A or LP_GPIO_11/M_QUAD_DEC2_A or LP_GPIO_12/M_QUAD_DEC2_A or LP_GPIO_13/M_QUAD_DEC2_A; QUAD_DEC2_B LP_GPIO_0/M_QUAD_DEC2_B or LP_GPIO_1/M_QUAD_DEC2_B or LP_GPIO_2/M_QUAD_DEC2_B or LP_GPIO_3/M_QUAD_DEC2_B or LP_GPIO_8/M_QUAD_DEC2_B or LP_GPIO_9/M_QUAD_DEC2_B or LP_GPIO_10/M_QUAD_DEC2_B or LP_GPIO_11/M_QUAD_DEC2_B or LP_GPIO_12/M_QUAD_DEC2_B or LP_GPIO_13/M_QUAD_DEC2_B
LP_CLK_CAL_REGS0 at 0x4000C000 (LP_CLK_CAL_REGS)
AON_SLEEP_TIMER0 at 0x4000D000 (AON_SLEEP_TIMER)
AON_PWR_SEQ0 at 0x4000E000 (AON_PWR_SEQ)
AON_GP_REGS0 at 0x4000F000 (AON_GP_REGS)
GPIO0 at 0x40010000 (GPIO)
  pins: P0 LP_GPIO_0; P1 LP_GPIO_1; P2 LP_GPIO_2; P3 LP_GPIO_3; P8 LP_GPIO_8; P9 LP_GPIO_9; P10 LP_GPIO_10; P11 LP_GPIO_11; P12 LP_GPIO_12; P13 LP_GPIO_13
GPIO1 at 0x40011000 (GPIO)
  pins: P31 AO_GPIO_0
GPIO2 at 0x40013000 (GPIO)
  pins: P47 GPIO_MS1
SPI_FLASH0 at 0x40012000 (SPI_FLASH)
  pins: SCK LP_GPIO_2/SPI_FLASH0_SCK or LP_GPIO_10/SPI_FLASH0_SCK; SSN LP_GPIO_8/SPI_FLASH0_SSN or LP_GPIO_12/SPI_FLASH0_SSN; TXD LP_GPIO_3/SPI_FLASH0_TXD or LP_GPIO_11/SPI_FLASH0_TXD; RXD LP_GPIO_9/SPI_FLASH0_RXD or LP_GPIO_13/SPI_FLASH0_RXD
  parameters: FLASH_SIZE=131072, PAGE_SIZE=64, PAGES=2048, ADDRESS_SPACE_REF=extflash
ARM_SYSCTRL0 at 0xE000E000 (ARM_SYSCTRL)
ARM_BPU0 at 0xE0002000 (ARM_BPU)
ARM_DWT0 at 0xE0001000 (ARM_DWT)
ARM_ROM0 at 0xE00FF000 (ARM_ROM)

## Interrupts
-14 NonMaskableInt_IRQn — Non Maskable Interrupt
-13 HardFault_IRQn — Hard Fault Interrupt
-5 SVCall_IRQn — SV Call Interrupt
-2 PendSV_IRQn — Pend SV Interrupt
-1 SysTick_IRQn — System Tick Interrupt
0 UART0_RX_IRQn (UART0)
1 UART0_TX_IRQn (UART0)
2 UART1_RX_IRQn (UART1)
3 UART1_TX_IRQn (UART1)
4 SPI0_RX_IRQn (SPI0)
5 SPI0_TX_IRQn (SPI0)
8 I2C0_RX_IRQn (I2C0)
9 I2C0_TX_IRQn (I2C0)
10 I2C1_RX_IRQn (I2C1)
11 I2C1_TX_IRQn (I2C1)
12 WDT0_IRQn (WDT0)
13 WDT1_IRQn (WDT1)
14 DUALTIMER0_IRQn (DUALTIMER0)
18 SPI_FLASH0_IRQn (SPI_FLASH0)
23 GPIO0_IRQn (GPIO0)
24 GPIO1_IRQn (GPIO1)
25 GPIO2_IRQn (GPIO2)
26 TIMER0_IRQn (TIMER0)
27 AON_SLEEP_TIMER0_IRQn (AON_SLEEP_TIMER0)

## Properties
SIGNATURES: LPMCU_CHIP_ID_REV_ID=0x002000B0

## Pinouts (pin number, pad)
BTLC1000WLCSP: A2 VDDIO_0, A4 XO_P, A6 VDD_VCO_VDD_SXDIG, B1 AO_GPIO_0, B3 VDDIO_SW, B5 XO_N, B7 RFIO, C2 RTC_CLK_P, C4 TPP, C6 VDD_RF, D1 RTC_CLK_N, D3 LP_GPIO_13, D5 LP_GPIO_0, D7 RFGND, E2 CHIP_EN, E4 VSS, E6 VDD_AMS, F1 LP_LDO_OUT_1P2, F3 GPIO_MS1, F5 LP_GPIO_11, F7 LP_GPIO_1, G2 VBATT_BUCK, G4 LP_GPIO_12, G6 LP_GPIO_2, H1 VDDC_PD4, H3 GND_BUCK, H5 LP_GPIO_9, H7 LP_GPIO_3, J2 VSW, J4 LP_GPIO_10, J6 LP_GPIO_8

## Notices in the file
Copyright (c) 2015, Atmel Corporation
All rights reserved.
