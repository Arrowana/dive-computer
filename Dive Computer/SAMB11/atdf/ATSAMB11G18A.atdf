# ATSAMB11G18A device description
Architecture: CORTEX-M0; Family: SAMB; Series: SAMB11
Parameters: PIO_API=samb, LITTLE_ENDIAN=1, __FPU_PRESENT=0, __CM0_REV=0x00, __NVIC_PRIO_BITS=2, __Vendor_SysTickConfig=0
Programming and debug interfaces: SWD
Registers are 32-bit, read-write, reset 0x0 unless marked. A register's access mark holds for its fields unless they carry their own. Offsets are from the block's base; lines under a group give offsets from that group; [hi:lo] are bit positions; {n}, {i} and the like mark numbered series; 'fields as' and 'values as' point back to an identical list; <NAME> marks a mode.

## Ordering variants
ATSAMB11G18A-MU: QFN48, pinout SAMB11G, up to 26 MHz, -40 to 85 C, 2.30 to 3.60 V

## Memory
base space: start 0 size 0x10042000, little endian
  0x0 BOOTROM size 0x20000 rom
  0x10000000 IDRAM size 0x20000 ram
  0x10040000 BLERAM size 0x2000 ram
  0x40000000 APB size 0x20000 io
extflash space: start 0 size 0x20000

## Peripheral instances (address, pins/pin function, parameters)
TIMER0 at 0x40000000 (TIMER)
DUALTIMER0 at 0x40001000 (DUALTIMER)
PROV_DMA_CTRL0 at 0x40002000 (PROV_DMA_CTRL)
I2C0 at 0x40003000 (I2C)
  pins: SDA LP_GPIO_8/M_I2C0_SDA or LP_GPIO_0/M_I2C0_SDA or LP_GPIO_1/M_I2C0_SDA or LP_GPIO_2/M_I2C0_SDA or LP_GPIO_3/M_I2C0_SDA or LP_GPIO_4/M_I2C0_SDA or LP_GPIO_5/M_I2C0_SDA or LP_GPIO_6/M_I2C0_SDA or LP_GPIO_7/M_I2C0_SDA or LP_GPIO_9/M_I2C0_SDA or LP_GPIO_10/M_I2C0_SDA or LP_GPIO_11/M_I2C0_SDA or LP_GPIO_12/M_I2C0_SDA or LP_GPIO_13/M_I2C0_SDA or LP_GPIO_14/M_I2C0_SDA or LP_GPIO_15/M_I2C0_SDA or LP_GPIO_16/M_I2C0_SDA or LP_GPIO_17/M_I2C0_SDA or LP_GPIO_18/M_I2C0_SDA or LP_GPIO_19/M_I2C0_SDA or LP_GPIO_20/M_I2C0_SDA or LP_GPIO_22/M_I2C0_SDA or LP_GPIO_23/M_I2C0_SDA; SCL LP_GPIO_9/M_I2C0_SCL or LP_GPIO_0/M_I2C0_SCL or LP_GPIO_1/M_I2C0_SCL or LP_GPIO_2/M_I2C0_SCL or LP_GPIO_3/M_I2C0_SCL or LP_GPIO_4/M_I2C0_SCL or LP_GPIO_5/M_I2C0_SCL or LP_GPIO_6/M_I2C0_SCL or LP_GPIO_7/M_I2C0_SCL or LP_GPIO_8/M_I2C0_SCL or LP_GPIO_10/M_I2C0_SCL or LP_GPIO_11/M_I2C0_SCL or LP_GPIO_12/M_I2C0_SCL or LP_GPIO_13/M_I2C0_SCL or LP_GPIO_14/M_I2C0_SCL or LP_GPIO_15/M_I2C0_SCL or LP_GPIO_16/M_I2C0_SCL or LP_GPIO_17/M_I2C0_SCL or LP_GPIO_18/M_I2C0_SCL or LP_GPIO_19/M_I2C0_SCL or LP_GPIO_20/M_I2C0_SCL or LP_GPIO_22/M_I2C0_SCL or LP_GPIO_23/M_I2C0_SCL
I2C1 at 0x40003400 (I2C)
  pins: SDA LP_GPIO_14/M_I2C1_SDA or LP_GPIO_0/M_I2C1_SDA or LP_GPIO_1/M_I2C1_SDA or LP_GPIO_2/M_I2C1_SDA or LP_GPIO_3/M_I2C1_SDA or LP_GPIO_4/M_I2C1_SDA or LP_GPIO_5/M_I2C1_SDA or LP_GPIO_6/M_I2C1_SDA or LP_GPIO_7/M_I2C1_SDA or LP_GPIO_8/M_I2C1_SDA or LP_GPIO_9/M_I2C1_SDA or LP_GPIO_10/M_I2C1_SDA or LP_GPIO_11/M_I2C1_SDA or LP_GPIO_12/M_I2C1_SDA or LP_GPIO_13/M_I2C1_SDA or LP_GPIO_15/M_I2C1_SDA or LP_GPIO_16/M_I2C1_SDA or LP_GPIO_17/M_I2C1_SDA or LP_GPIO_18/M_I2C1_SDA or LP_GPIO_19/M_I2C1_SDA or LP_GPIO_20/M_I2C1_SDA or LP_GPIO_22/M_I2C1_SDA or LP_GPIO_23/M_I2C1_SDA; SCL LP_GPIO_15/M_I2C1_SCL or LP_GPIO_0/M_I2C1_SCL or LP_GPIO_1/M_I2C1_SCL or LP_GPIO_2/M_I2C1_SCL or LP_GPIO_3/M_I2C1_SCL or LP_GPIO_4/M_I2C1_SCL or LP_GPIO_5/M_I2C1_SCL or LP_GPIO_6/M_I2C1_SCL or LP_GPIO_7/M_I2C1_SCL or LP_GPIO_8/M_I2C1_SCL or LP_GPIO_9/M_I2C1_SCL or LP_GPIO_10/M_I2C1_SCL or LP_GPIO_11/M_I2C1_SCL or LP_GPIO_12/M_I2C1_SCL or LP_GPIO_13/M_I2C1_SCL or LP_GPIO_14/M_I2C1_SCL or LP_GPIO_16/M_I2C1_SCL or LP_GPIO_17/M_I2C1_SCL or LP_GPIO_18/M_I2C1_SCL or LP_GPIO_19/M_I2C1_SCL or LP_GPIO_20/M_I2C1_SCL or LP_GPIO_22/M_I2C1_SCL or LP_GPIO_23/M_I2C1_SCL
UART0 at 0x40004000 (UART)
  pins: RXD LP_GPIO_2/M_UART0_RXD or LP_GPIO_0/M_UART0_RXD or LP_GPIO_1/M_UART0_RXD or LP_GPIO_3/M_UART0_RXD or LP_GPIO_4/M_UART0_RXD or LP_GPIO_5/M_UART0_RXD or LP_GPIO_6/M_UART0_RXD or LP_GPIO_7/M_UART0_RXD or LP_GPIO_8/M_UART0_RXD or LP_GPIO_9/M_UART0_RXD or LP_GPIO_10/M_UART0_RXD or LP_GPIO_11/M_UART0_RXD or LP_GPIO_12/M_UART0_RXD or LP_GPIO_13/M_UART0_RXD or LP_GPIO_14/M_UART0_RXD or LP_GPIO_15/M_UART0_RXD or LP_GPIO_16/M_UART0_RXD or LP_GPIO_17/M_UART0_RXD or LP_GPIO_18/M_UART0_RXD or LP_GPIO_19/M_UART0_RXD or LP_GPIO_20/M_UART0_RXD or LP_GPIO_22/M_UART0_RXD or LP_GPIO_23/M_UART0_RXD; TXD LP_GPIO_3/M_UART0_TXD or LP_GPIO_0/M_UART0_TXD or LP_GPIO_1/M_UART0_TXD or LP_GPIO_2/M_UART0_TXD or LP_GPIO_4/M_UART0_TXD or LP_GPIO_5/M_UART0_TXD or LP_GPIO_6/M_UART0_TXD or LP_GPIO_7/M_UART0_TXD or LP_GPIO_8/M_UART0_TXD or LP_GPIO_9/M_UART0_TXD or LP_GPIO_10/M_UART0_TXD or LP_GPIO_11/M_UART0_TXD or LP_GPIO_12/M_UART0_TXD or LP_GPIO_13/M_UART0_TXD or LP_GPIO_14/M_UART0_TXD or LP_GPIO_15/M_UART0_TXD or LP_GPIO_16/M_UART0_TXD or LP_GPIO_17/M_UART0_TXD or LP_GPIO_18/M_UART0_TXD or LP_GPIO_19/M_UART0_TXD or LP_GPIO_20/M_UART0_TXD or LP_GPIO_22/M_UART0_TXD or LP_GPIO_23/M_UART0_TXD; CTS LP_GPIO_4/M_UART0_CTS or LP_GPIO_0/M_UART0_CTS or LP_GPIO_1/M_UART0_CTS or LP_GPIO_2/M_UART0_CTS or LP_GPIO_3/M_UART0_CTS or LP_GPIO_5/M_UART0_CTS or LP_GPIO_6/M_UART0_CTS or LP_GPIO_7/M_UART0_CTS or LP_GPIO_8/M_UART0_CTS or LP_GPIO_9/M_UART0_CTS or LP_GPIO_10/M_UART0_CTS or LP_GPIO_11/M_UART0_CTS or LP_GPIO_12/M_UART0_CTS or LP_GPIO_13/M_UART0_CTS or LP_GPIO_14/M_UART0_CTS or LP_GPIO_15/M_UART0_CTS or LP_GPIO_16/M_UART0_CTS or LP_GPIO_17/M_UART0_CTS or LP_GPIO_18/M_UART0_CTS or LP_GPIO_19/M_UART0_CTS or LP_GPIO_20/M_UART0_CTS or LP_GPIO_22/M_UART0_CTS or LP_GPIO_23/M_UART0_CTS; RTS LP_GPIO_5/M_UART0_RTS or LP_GPIO_0/M_UART0_RTS or LP_GPIO_1/M_UART0_RTS or LP_GPIO_2/M_UART0_RTS or LP_GPIO_3/M_UART0_RTS or LP_GPIO_4/M_UART0_RTS or LP_GPIO_6/M_UART0_RTS or LP_GPIO_7/M_UART0_RTS or LP_GPIO_8/M_UART0_RTS or LP_GPIO_9/M_UART0_RTS or LP_GPIO_10/M_UART0_RTS or LP_GPIO_11/M_UART0_RTS or LP_GPIO_12/M_UART0_RTS or LP_GPIO_13/M_UART0_RTS or LP_GPIO_14/M_UART0_RTS or LP_GPIO_15/M_UART0_RTS or LP_GPIO_16/M_UART0_RTS or LP_GPIO_17/M_UART0_RTS or LP_GPIO_18/M_UART0_RTS or LP_GPIO_19/M_UART0_RTS or LP_GPIO_20/M_UART0_RTS or LP_GPIO_22/M_UART0_RTS or LP_GPIO_23/M_UART0_RTS
UART1 at 0x40005000 (UART)
  pins: RXD LP_GPIO_6/M_UART1_RXD or LP_GPIO_0/M_UART1_RXD or LP_GPIO_1/M_UART1_RXD or LP_GPIO_2/M_UART1_RXD or LP_GPIO_3/M_UART1_RXD or LP_GPIO_4/M_UART1_RXD or LP_GPIO_5/M_UART1_RXD or LP_GPIO_7/M_UART1_RXD or LP_GPIO_8/M_UART1_RXD or LP_GPIO_9/M_UART1_RXD or LP_GPIO_10/M_UART1_RXD or LP_GPIO_11/M_UART1_RXD or LP_GPIO_12/M_UART1_RXD or LP_GPIO_13/M_UART1_RXD or LP_GPIO_14/M_UART1_RXD or LP_GPIO_15/M_UART1_RXD or LP_GPIO_16/M_UART1_RXD or LP_GPIO_17/M_UART1_RXD or LP_GPIO_18/M_UART1_RXD or LP_GPIO_19/M_UART1_RXD or LP_GPIO_20/M_UART1_RXD or LP_GPIO_22/M_UART1_RXD or LP_GPIO_23/M_UART1_RXD; TXD LP_GPIO_7/M_UART1_TXD or LP_GPIO_0/M_UART1_TXD or LP_GPIO_1/M_UART1_TXD or LP_GPIO_2/M_UART1_TXD or LP_GPIO_3/M_UART1_TXD or LP_GPIO_4/M_UART1_TXD or LP_GPIO_5/M_UART1_TXD or LP_GPIO_6/M_UART1_TXD or LP_GPIO_8/M_UART1_TXD or LP_GPIO_9/M_UART1_TXD or LP_GPIO_10/M_UART1_TXD or LP_GPIO_11/M_UART1_TXD or LP_GPIO_12/M_UART1_TXD or LP_GPIO_13/M_UART1_TXD or LP_GPIO_14/M_UART1_TXD or LP_GPIO_15/M_UART1_TXD or LP_GPIO_16/M_UART1_TXD or LP_GPIO_17/M_UART1_TXD or LP_GPIO_18/M_UART1_TXD or LP_GPIO_19/M_UART1_TXD or LP_GPIO_20/M_UART1_TXD or LP_GPIO_22/M_UART1_TXD or LP_GPIO_23/M_UART1_TXD; CTS LP_GPIO_14/M_UART1_CTS or LP_GPIO_0/M_UART1_CTS or LP_GPIO_1/M_UART1_CTS or LP_GPIO_2/M_UART1_CTS or LP_GPIO_3/M_UART1_CTS or LP_GPIO_4/M_UART1_CTS or LP_GPIO_5/M_UART1_CTS or LP_GPIO_6/M_UART1_CTS or LP_GPIO_7/M_UART1_CTS or LP_GPIO_8/M_UART1_CTS or LP_GPIO_9/M_UART1_CTS or LP_GPIO_10/M_UART1_CTS or LP_GPIO_11/M_UART1_CTS or LP_GPIO_12/M_UART1_CTS or LP_GPIO_13/M_UART1_CTS or LP_GPIO_15/M_UART1_CTS or LP_GPIO_16/M_UART1_CTS or LP_GPIO_17/M_UART1_CTS or LP_GPIO_18/M_UART1_CTS or LP_GPIO_19/M_UART1_CTS or LP_GPIO_20/M_UART1_CTS or LP_GPIO_22/M_UART1_CTS or LP_GPIO_23/M_UART1_CTS; RTS LP_GPIO_15/M_UART1_RTS or LP_GPIO_0/M_UART1_RTS or LP_GPIO_1/M_UART1_RTS or LP_GPIO_2/M_UART1_RTS or LP_GPIO_3/M_UART1_RTS or LP_GPIO_4/M_UART1_RTS or LP_GPIO_5/M_UART1_RTS or LP_GPIO_6/M_UART1_RTS or LP_GPIO_7/M_UART1_RTS or LP_GPIO_8/M_UART1_RTS or LP_GPIO_9/M_UART1_RTS or LP_GPIO_10/M_UART1_RTS or LP_GPIO_11/M_UART1_RTS or LP_GPIO_12/M_UART1_RTS or LP_GPIO_13/M_UART1_RTS or LP_GPIO_14/M_UART1_RTS or LP_GPIO_16/M_UART1_RTS or LP_GPIO_17/M_UART1_RTS or LP_GPIO_18/M_UART1_RTS or LP_GPIO_19/M_UART1_RTS or LP_GPIO_20/M_UART1_RTS or LP_GPIO_22/M_UART1_RTS or LP_GPIO_23/M_UART1_RTS
SPI0 at 0x40006000 (SPI)
  pins: SCK LP_GPIO_2/SPI0_SCK or LP_GPIO_6/SPI0_SCK or LP_GPIO_16/SPI0_SCK or LP_GPIO_10/SPI0_SCK; MOSI LP_GPIO_3/SPI0_MOSI or LP_GPIO_7/SPI0_MOSI or LP_GPIO_17/SPI0_MOSI or LP_GPIO_11/SPI0_MOSI; SSN LP_GPIO_4/SPI0_SSN or LP_GPIO_8/SPI0_SSN or LP_GPIO_18/SPI0_SSN or LP_GPIO_12/SPI0_SSN; MISO LP_GPIO_5/SPI0_MISO or LP_GPIO_9/SPI0_MISO or LP_GPIO_19/SPI0_MISO or LP_GPIO_13/SPI0_MISO
SPI1 at 0x40007000 (SPI)
  pins: SCK LP_GPIO_2/SPI1_SCK or LP_GPIO_17/SPI1_SCK; MOSI LP_GPIO_3/SPI1_MOSI or LP_GPIO_19/SPI1_MOSI; SSN LP_GPIO_4/SPI1_SSN or LP_GPIO_16/SPI1_SSN; MISO LP_GPIO_5/SPI1_MISO or LP_GPIO_18/SPI1_MISO
WDT0 at 0x40008000 (WDT)
WDT1 at 0x40009000 (WDT)
EFUSE_MISC_REGS0 at 0x4000A000 (EFUSE_MISC_REGS)
LPMCU_MISC_REGS0 at 0x4000B000 (LPMCU_MISC_REGS)
  pins: PWM0_OUT LP_GPIO_0/M_PWM0_OUT or LP_GPIO_1/M_PWM0_OUT or LP_GPIO_2/M_PWM0_OUT or LP_GPIO_3/M_PWM0_OUT or LP_GPIO_4/M_PWM0_OUT or LP_GPIO_5/M_PWM0_OUT or LP_GPIO_6/M_PWM0_OUT or LP_GPIO_7/M_PWM0_OUT or LP_GPIO_8/M_PWM0_OUT or LP_GPIO_9/M_PWM0_OUT or LP_GPIO_10/M_PWM0_OUT or LP_GPIO_11/M_PWM0_OUT or LP_GPIO_12/M_PWM0_OUT or LP_GPIO_13/M_PWM0_OUT or LP_GPIO_14/M_PWM0_OUT or LP_GPIO_15/M_PWM0_OUT or LP_GPIO_16/M_PWM0_OUT or LP_GPIO_17/M_PWM0_OUT or LP_GPIO_18/M_PWM0_OUT or LP_GPIO_19/M_PWM0_OUT or LP_GPIO_20/M_PWM0_OUT or LP_GPIO_22/M_PWM0_OUT or LP_GPIO_23/M_PWM0_OUT; PWM1_OUT LP_GPIO_0/M_PWM1_OUT or LP_GPIO_1/M_PWM1_OUT or LP_GPIO_2/M_PWM1_OUT or LP_GPIO_3/M_PWM1_OUT or LP_GPIO_4/M_PWM1_OUT or LP_GPIO_5/M_PWM1_OUT or LP_GPIO_6/M_PWM1_OUT or LP_GPIO_7/M_PWM1_OUT or LP_GPIO_8/M_PWM1_OUT or LP_GPIO_9/M_PWM1_OUT or LP_GPIO_10/M_PWM1_OUT or LP_GPIO_11/M_PWM1_OUT or LP_GPIO_12/M_PWM1_OUT or LP_GPIO_13/M_PWM1_OUT or LP_GPIO_14/M_PWM1_OUT or LP_GPIO_15/M_PWM1_OUT or LP_GPIO_16/M_PWM1_OUT or LP_GPIO_17/M_PWM1_OUT or LP_GPIO_18/M_PWM1_OUT or LP_GPIO_19/M_PWM1_OUT or LP_GPIO_20/M_PWM1_OUT or LP_GPIO_22/M_PWM1_OUT or LP_GPIO_23/M_PWM1_OUT; PWM2_OUT LP_GPIO_0/M_PWM2_OUT or LP_GPIO_1/M_PWM2_OUT or LP_GPIO_2/M_PWM2_OUT or LP_GPIO_3/M_PWM2_OUT or LP_GPIO_4/M_PWM2_OUT or LP_GPIO_5/M_PWM2_OUT or LP_GPIO_6/M_PWM2_OUT or LP_GPIO_7/M_PWM2_OUT or LP_GPIO_8/M_PWM2_OUT or LP_GPIO_9/M_PWM2_OUT or LP_GPIO_10/M_PWM2_OUT or LP_GPIO_11/M_PWM2_OUT or LP_GPIO_12/M_PWM2_OUT or LP_GPIO_13/M_PWM2_OUT or LP_GPIO_14/M_PWM2_OUT or LP_GPIO_15/M_PWM2_OUT or LP_GPIO_16/M_PWM2_OUT or LP_GPIO_17/M_PWM2_OUT or LP_GPIO_18/M_PWM2_OUT or LP_GPIO_19/M_PWM2_OUT or LP_GPIO_20/M_PWM2_OUT or LP_GPIO_22/M_PWM2_OUT or LP_GPIO_23/M_PWM2_OUT; PWM3_OUT LP_GPIO_0/M_PWM3_OUT or LP_GPIO_1/M_PWM3_OUT or LP_GPIO_2/M_PWM3_OUT or LP_GPIO_3/M_PWM3_OUT or LP_GPIO_4/M_PWM3_OUT or LP_GPIO_5/M_PWM3_OUT or LP_GPIO_6/M_PWM3_OUT or LP_GPIO_7/M_PWM3_OUT or LP_GPIO_8/M_PWM3_OUT or LP_GPIO_9/M_PWM3_OUT or LP_GPIO_10/M_PWM3_OUT or LP_GPIO_11/M_PWM3_OUT or LP_GPIO_12/M_PWM3_OUT or LP_GPIO_13/M_PWM3_OUT or LP_GPIO_14/M_PWM3_OUT or LP_GPIO_15/M_PWM3_OUT or LP_GPIO_16/M_PWM3_OUT or LP_GPIO_17/M_PWM3_OUT or LP_GPIO_18/M_PWM3_OUT or LP_GPIO_19/M_PWM3_OUT or LP_GPIO_20/M_PWM3_OUT or LP_GPIO_22/M_PWM3_OUT or LP_GPIO_23/M_PWM3_OUT; QUAD_DEC0_A LP_GPIO_0/M_QUAD_DEC0_A or LP_GPIO_1/M_QUAD_DEC0_A or LP_GPIO_2/M_QUAD_DEC0_A or LP_GPIO_3/M_QUAD_DEC0_A or LP_GPIO_4/M_QUAD_DEC0_A or LP_GPIO_5/M_QUAD_DEC0_A or LP_GPIO_6/M_QUAD_DEC0_A or LP_GPIO_7/M_QUAD_DEC0_A or LP_GPIO_8/M_QUAD_DEC0_A or LP_GPIO_9/M_QUAD_DEC0_A or LP_GPIO_10/M_QUAD_DEC0_A or LP_GPIO_11/M_QUAD_DEC0_A or LP_GPIO_12/M_QUAD_DEC0_A or LP_GPIO_13/M_QUAD_DEC0_A or LP_GPIO_14/M_QUAD_DEC0_A or LP_GPIO_15/M_QUAD_DEC0_A or LP_GPIO_16/M_QUAD_DEC0_A or LP_GPIO_17/M_QUAD_DEC0_A or LP_GPIO_18/M_QUAD_DEC0_A or LP_GPIO_19/M_QUAD_DEC0_A or LP_GPIO_20/M_QUAD_DEC0_A or LP_GPIO_22/M_QUAD_DEC0_A or LP_GPIO_23/M_QUAD_DEC0_A; QUAD_DEC0_B LP_GPIO_0/M_QUAD_DEC0_B or LP_GPIO_1/M_QUAD_DEC0_B or LP_GPIO_2/M_QUAD_DEC0_B or LP_GPIO_3/M_QUAD_DEC0_B or LP_GPIO_4/M_QUAD_DEC0_B or LP_GPIO_5/M_QUAD_DEC0_B or LP_GPIO_6/M_QUAD_DEC0_B or LP_GPIO_7/M_QUAD_DEC0_B or LP_GPIO_8/M_QUAD_DEC0_B or LP_GPIO_9/M_QUAD_DEC0_B or LP_GPIO_10/M_QUAD_DEC0_B or LP_GPIO_11/M_QUAD_DEC0_B or LP_GPIO_12/M_QUAD_DEC0_B or LP_GPIO_13/M_QUAD_DEC0_B or LP_GPIO_14/M_QUAD_DEC0_B or LP_GPIO_15/M_QUAD_DEC0_B or LP_GPIO_16/M_QUAD_DEC0_B or LP_GPIO_17/M_QUAD_DEC0_B or LP_GPIO_18/M_QUAD_DEC0_B or LP_GPIO_19/M_QUAD_DEC0_B or LP_GPIO_20/M_QUAD_DEC0_B or LP_GPIO_22/M_QUAD_DEC0_B or LP_GPIO_23/M_QUAD_DEC0_B; QUAD_DEC1_A LP_GPIO_0/M_QUAD_DEC1_A or LP_GPIO_1/M_QUAD_DEC1_A or LP_GPIO_2/M_QUAD_DEC1_A or LP_GPIO_3/M_QUAD_DEC1_A or LP_GPIO_4/M_QUAD_DEC1_A or LP_GPIO_5/M_QUAD_DEC1_A or LP_GPIO_6/M_QUAD_DEC1_A or LP_GPIO_7/M_QUAD_DEC1_A or LP_GPIO_8/M_QUAD_DEC1_A or LP_GPIO_9/M_QUAD_DEC1_A or LP_GPIO_10/M_QUAD_DEC1_A or LP_GPIO_11/M_QUAD_DEC1_A or LP_GPIO_12/M_QUAD_DEC1_A or LP_GPIO_13/M_QUAD_DEC1_A or LP_GPIO_14/M_QUAD_DEC1_A or LP_GPIO_15/M_QUAD_DEC1_A or LP_GPIO_16/M_QUAD_DEC1_A or LP_GPIO_17/M_QUAD_DEC1_A or LP_GPIO_18/M_QUAD_DEC1_A or LP_GPIO_19/M_QUAD_DEC1_A or LP_GPIO_20/M_QUAD_DEC1_A or LP_GPIO_22/M_QUAD_DEC1_A or LP_GPIO_23/M_QUAD_DEC1_A; QUAD_DEC1_B LP_GPIO_0/M_QUAD_DEC1_B or LP_GPIO_1/M_QUAD_DEC1_B or LP_GPIO_2/M_QUAD_DEC1_B or LP_GPIO_3/M_QUAD_DEC1_B or LP_GPIO_4/M_QUAD_DEC1_B or LP_GPIO_5/M_QUAD_DEC1_B or LP_GPIO_6/M_QUAD_DEC1_B or LP_GPIO_7/M_QUAD_DEC1_B or LP_GPIO_8/M_QUAD_DEC1_B or LP_GPIO_9/M_QUAD_DEC1_B or LP_GPIO_10/M_QUAD_DEC1_B or LP_GPIO_11/M_QUAD_DEC1_B or LP_GPIO_12/M_QUAD_DEC1_B or LP_GPIO_13/M_QUAD_DEC1_B or LP_GPIO_14/M_QUAD_DEC1_B or LP_GPIO_15/M_QUAD_DEC1_B or LP_GPIO_16/M_QUAD_DEC1_B or LP_GPIO_17/M_QUAD_DEC1_B or LP_GPIO_18/M_QUAD_DEC1_B or LP_GPIO_19/M_QUAD_DEC1_B or LP_GPIO_20/M_QUAD_DEC1_B or LP_GPIO_22/M_QUAD_DEC1_B or LP_GPIO_23/M_QUAD_DEC1_B; QUAD_DEC2_A LP_GPIO_0/M_QUAD_DEC2_A or LP_GPIO_1/M_QUAD_DEC2_A or LP_GPIO_2/M_QUAD_DEC2_A or LP_GPIO_3/M_QUAD_DEC2_A or LP_GPIO_4/M_QUAD_DEC2_A or LP_GPIO_5/M_QUAD_DEC2_A or LP_GPIO_6/M_QUAD_DEC2_A or LP_GPIO_7/M_QUAD_DEC2_A or LP_GPIO_8/M_QUAD_DEC2_A or LP_GPIO_9/M_QUAD_DEC2_A or LP_GPIO_10/M_QUAD_DEC2_A or LP_GPIO_11/M_QUAD_DEC2_A or LP_GPIO_12/M_QUAD_DEC2_A or LP_GPIO_13/M_QUAD_DEC2_A or LP_GPIO_14/M_QUAD_DEC2_A or LP_GPIO_15/M_QUAD_DEC2_A or LP_GPIO_16/M_QUAD_DEC2_A or LP_GPIO_17/M_QUAD_DEC2_A or LP_GPIO_18/M_QUAD_DEC2_A or LP_GPIO_19/M_QUAD_DEC2_A or LP_GPIO_20/M_QUAD_DEC2_A or LP_GPIO_22/M_QUAD_DEC2_A or LP_GPIO_23/M_QUAD_DEC2_A; QUAD_DEC2_B LP_GPIO_0/M_QUAD_DEC2_B or LP_GPIO_1/M_QUAD_DEC2_B or LP_GPIO_2/M_QUAD_DEC2_B or LP_GPIO_3/M_QUAD_DEC2_B or LP_GPIO_4/M_QUAD_DEC2_B or LP_GPIO_5/M_QUAD_DEC2_B or LP_GPIO_6/M_QUAD_DEC2_B or LP_GPIO_7/M_QUAD_DEC2_B or LP_GPIO_8/M_QUAD_DEC2_B or LP_GPIO_9/M_QUAD_DEC2_B or LP_GPIO_10/M_QUAD_DEC2_B or LP_GPIO_11/M_QUAD_DEC2_B or LP_GPIO_12/M_QUAD_DEC2_B or LP_GPIO_13/M_QUAD_DEC2_B or LP_GPIO_14/M_QUAD_DEC2_B or LP_GPIO_15/M_QUAD_DEC2_B or LP_GPIO_16/M_QUAD_DEC2_B or LP_GPIO_17/M_QUAD_DEC2_B or LP_GPIO_18/M_QUAD_DEC2_B or LP_GPIO_19/M_QUAD_DEC2_B or LP_GPIO_20/M_QUAD_DEC2_B or LP_GPIO_22/M_QUAD_DEC2_B or LP_GPIO_23/M_QUAD_DEC2_B
LP_CLK_CAL_REGS0 at 0x4000C000 (LP_CLK_CAL_REGS)
AON_SLEEP_TIMER0 at 0x4000D000 (AON_SLEEP_TIMER)
AON_PWR_SEQ0 at 0x4000E000 (AON_PWR_SEQ)
AON_GP_REGS0 at 0x4000F000 (AON_GP_REGS)
GPIO0 at 0x40010000 (GPIO)
  pins: P{n} LP_GPIO_{n} (n=0..15)
GPIO1 at 0x40011000 (GPIO)
  pins: P16 LP_GPIO_16; P17 LP_GPIO_17; P18 LP_GPIO_18; P19 LP_GPIO_19; P20 LP_GPIO_20; P22 LP_GPIO_22; P23 LP_GPIO_23; P29 AO_GPIO_2; P30 AO_GPIO_1; P31 AO_GPIO_0
GPIO2 at 0x40013000 (GPIO)
  pins: P44 GPIO_MS4; P45 GPIO_MS3; P46 GPIO_MS2; P47 GPIO_MS1
SPI_FLASH0 at 0x40012000 (SPI_FLASH)
  pins: SCK LP_SIP_0/SPI_FLASH0_SCK or LP_GPIO_2/SPI_FLASH0_SCK or LP_GPIO_6/SPI_FLASH0_SCK or LP_GPIO_10/SPI_FLASH0_SCK or LP_GPIO_16/SPI_FLASH0_SCK; SSN LP_SIP_2/SPI_FLASH0_SSN or LP_GPIO_4/SPI_FLASH0_SSN or LP_GPIO_8/SPI_FLASH0_SSN or LP_GPIO_12/SPI_FLASH0_SSN or LP_GPIO_16/SPI_FLASH0_SSN or LP_GPIO_18/SPI_FLASH0_SSN; TXD LP_SIP_1/SPI_FLASH0_TXD or LP_GPIO_3/SPI_FLASH0_TXD or LP_GPIO_7/SPI_FLASH0_TXD or LP_GPIO_11/SPI_FLASH0_TXD or LP_GPIO_17/SPI_FLASH0_TXD; RXD LP_SIP_3/SPI_FLASH0_RXD or LP_GPIO_5/SPI_FLASH0_RXD or LP_GPIO_9/SPI_FLASH0_RXD or LP_GPIO_13/SPI_FLASH0_RXD or LP_GPIO_18/SPI_FLASH0_RXD or LP_GPIO_19/SPI_FLASH0_RXD; WP LP_SIP_4/SPI_FLASH0_WP
  parameters: FLASH_SIZE=131072, PAGE_SIZE=64, PAGES=2048, ADDRESS_SPACE_REF=extflash
ARM_SYSCTRL0 at 0xE000E000 (ARM_SYSCTRL)
ARM_BPU0 at 0xE0002000 (ARM_BPU)
ARM_DWT0 at 0xE0001000 (ARM_DWT)
ARM_ROM0 at 0xE00FF000 (ARM_ROM)

## Interrupts
-14 NonMaskableInt_IRQn — Non Maskable Interrupt
-13 HardFault_IRQn — Hard Fault Interrupt
-5 SVCall_IRQn — SV Call Interrupt
-2 PendSV_IRQn — Pend SV Interrupt
-1 SysTick_IRQn — System Tick Interrupt
0 UART0_RX_IRQn (UART0)
1 UART0_TX_IRQn (UART0)
2 UART1_RX_IRQn (UART1)
3 UART1_TX_IRQn (UART1)
4 SPI0_RX_IRQn (SPI0)
5 SPI0_TX_IRQn (SPI0)
6 SPI1_RX_IRQn (SPI1)
7 SPI1_TX_IRQn (SPI1)
8 I2C0_RX_IRQn (I2C0)
9 I2C0_TX_IRQn (I2C0)
10 I2C1_RX_IRQn (I2C1)
11 I2C1_TX_IRQn (I2C1)
12 WDT0_IRQn (WDT0)
13 WDT1_IRQn (WDT1)
14 DUALTIMER0_IRQn (DUALTIMER0)
18 SPI_FLASH0_IRQn (SPI_FLASH0)
23 GPIO0_IRQn (GPIO0)
24 GPIO1_IRQn (GPIO1)
25 GPIO2_IRQn (GPIO2)
26 TIMER0_IRQn (TIMER0)
27 AON_SLEEP_TIMER0_IRQn (AON_SLEEP_TIMER0)

## Properties
SIGNATURES: LPMCU_CHIP_ID_REV_ID=0x002000B0

## Pinouts (pin number, pad)
SAMB11G: 1 VDD_VCO, 2 VDD_RF, 3 RFIO, 4 VDD_AMS, 5 LP_GPIO_0, 6 LP_GPIO_1, 7 LP_GPIO_2, 8 LP_GPIO_3, 9 LP_GPIO_4, 10 LP_GPIO_22, 11 LP_GPIO_23, 12 LP_GPIO_5, 13 LP_GPIO_6, 14 LP_GPIO_7, 15 LP_GPIO_8, 16 LP_GPIO_9, 17 LP_GPIO_10, 18 LP_GPIO_11, 19 LP_GPIO_12, 20 LP_GPIO_13, 21 VSW, 22 VBATT_BUCK, 23 VDDC_PD4, 24 GPIO_MS1, 25 GPIO_MS2, 26 CHIP_EN, 27 GPIO_MS3, 28 GPIO_MS4, 29 LP_LDO_OUT_1P2, 30 RTC_CLK_P, 31 RTC_CLK_N, 32 AO_TEST_MODE, 33 AO_GPIO_0, 34 AO_GPIO_1, 35 AO_GPIO_2, 36 LP_GPIO_14, 37 LP_GPIO_15, 38 LP_GPIO_16, 39 VDDIO_0, 40 LP_GPIO_17, 41 LP_GPIO_18, 42 LP_GPIO_19, 43 LP_GPIO_20, 44 XO_P, 45 XO_N, 46 TPP, 47 TPN, 48 VDD_SXDIG

## Notices in the file
Copyright (c) 2015, Atmel Corporation
All rights reserved.
